/* symbols used only by the US v1.0 sources of versions/us/src (release addresses) */
D_auto_800E0D5C = 0x800E0D5C;
D_800D298C = 0x800CD64C;
D_auto_800C5410 = 0x800C5410;
func_auto_0044E1D0 = 0x44E1D0;
D_00450830 = 0x0044FD50;
D_00450BAC = 0x004500CC;
func_00295B90 = 0x00294BD0; /* c_syms.ld says 0x00295B90; release ROM 0x957D0 is the 1.1 func_00295B90 code (relocs aside) */
D_800CA680 = 0x800C5420; /* c_syms.ld says 0x800CA680 (unmapped); referenced by func_auto_00295DEC / func_auto_00295E54 (1.1 func_00296E04/func_00296EC4) */
D_8014D070 = 0x80144DF0;
D_8014D074 = 0x80144DF4;
D_8014D078 = 0x80144DF8;
D_8014D07C = 0x80144DFC;
D_auto_00202460 = 0x00202460;
PROVIDE(func_00202268 = 0x00202268);
