/* symbols used only by the Germany sources of versions/de/src (release addresses) */
D_auto_800CC390 = 0x800CC390;
D_auto_800CC3A0 = 0x800CC3A0;
D_auto_800E03B0 = 0x800E03B0;
D_auto_800E0450 = 0x800E0450;
D_auto_800E04C0 = 0x800E04C0;
D_auto_800E1850 = 0x800E1850;
D_auto_801371FC = 0x801371FC;
D_auto_8014DE60 = 0x8014DE60;
D_auto_8014DE64 = 0x8014DE64;
func_auto_002BB5E0 = 0x002BB5E0;   /* jal target inside __osSetGlobalIntMask (epilogue) from mis-split words at 0x2A0ACC; asm only, keeps the word */
D_auto_800C54F0 = 0x800C54F0;
D_auto_800C922C = 0x800C922C;
D_auto_800CD894 = 0x800CD894;
D_auto_800E20AC = 0x800E20AC;
func_auto_00294C90 = 0x00294C90;   /* real entry behind two stray words (same as EU 0x294DB0), called by the cascaded func_auto_00295EAC */
func_auto_002BA180 = 0x002BA180;   /* jal target 0x40 into func_002BF230 from asm BAD3C.s */
D_auto_80146CE0 = 0x80146CE0;
D_auto_80146DF0 = 0x80146DF0;
D_auto_80146DF4 = 0x80146DF4;
D_auto_80146DF8 = 0x80146DF8;
D_auto_80146DFC = 0x80146DFC;

PROVIDE(func_auto_002023DC = 0x002023DC);
PROVIDE(func_auto_0021B468 = 0x0021B468);
PROVIDE(func_auto_0021BFC4 = 0x0021BFC4);
PROVIDE(func_auto_0021C45C = 0x0021C45C);
PROVIDE(func_auto_00229814 = 0x00229814);
PROVIDE(func_auto_0024F950 = 0x0024F950);
PROVIDE(func_auto_0024FD80 = 0x0024FD80);
PROVIDE(func_auto_00255280 = 0x00255280);
D_auto_800C53B0 = 0x800C53B0;
D_auto_800C5420 = 0x800C5420;
D_auto_800C5424 = 0x800C5424;
PROVIDE(func_44ECB0 = 0x44E060);
PROVIDE(func_004293AC = 0x004291D0);
D_800E1AAC = 0x800DDA7C;
PROVIDE(func_004427C4 = 0x004427C4);
PROVIDE(func_00202268 = 0x00202268);
